/* Independently implemented from Semtech SX1276/77/78/79 register documentation.
 * No Semtech/Ebyte driver code is incorporated. See plugin README for sources. */
#include "sx1278_chip.h"
#include "air_link_config.h"
#include <stddef.h>
#include <string.h>

_Static_assert((AIR_LINK_FREQUENCY_HZ == 433000000UL) &&
    (AIR_LINK_TX_POWER_DBM == 17) && (AIR_LINK_SPREADING_FACTOR == 7U) &&
    (AIR_LINK_BANDWIDTH_HZ == 125000UL) &&
    (AIR_LINK_CODING_RATE_DENOMINATOR == 5U) &&
    (AIR_LINK_PREAMBLE_SYMBOLS == 16U) && (AIR_LINK_PACKET_MTU == 61U),
    "SX1278 experimental profile must be generated by its own validator");

static Sx1278Result Sx1278Chip_Transfer(const Sx1278ChipBus *bus,
    uint8_t address, const uint8_t *input, uint8_t *output, uint8_t length)
{
    uint8_t tx[SX1278_PACKET_CAPACITY + 1U] = {0};
    uint8_t rx[SX1278_PACKET_CAPACITY + 1U] = {0};
    PlatformResult result;
    PlatformResult released;
    if ((bus == NULL) || (bus->spi >= PLATFORM_SPI_COUNT) ||
        (bus->nss >= PLATFORM_GPIO_COUNT) || (length == 0U) ||
        (length > SX1278_PACKET_CAPACITY) ||
        (((address & 0x7FU) != 0U) &&
         ((uint32_t)(address & 0x7FU) + length > 128U))) { return Sx1278Result_Invalid; }
    tx[0] = address;
    if (input != NULL) { (void)memcpy(&tx[1], input, length); }
    result = PlatformGpio_Write(bus->nss, 0U);
    if (result == PLATFORM_OK)
    { result = PlatformSpi_Transfer(bus->spi, tx, rx, (uint16_t)(length + 1U), 2U); }
    /* Release NSS on every exit after the assertion attempt, including faults. */
    released = PlatformGpio_Write(bus->nss, 1U);
    if ((result == PLATFORM_TIMEOUT) || (released == PLATFORM_TIMEOUT))
    { return Sx1278Result_Timeout; }
    if ((result != PLATFORM_OK) || (released != PLATFORM_OK)) { return Sx1278Result_Io; }
    if (output != NULL) { (void)memcpy(output, &rx[1], length); }
    return Sx1278Result_Ok;
}

Sx1278Result Sx1278Chip_Read(const Sx1278ChipBus *bus, uint8_t address,
    uint8_t *data, uint8_t length)
{
    if ((data == NULL) || (address > 0x7FU)) { return Sx1278Result_Invalid; }
    return Sx1278Chip_Transfer(bus, address, NULL, data, length);
}

Sx1278Result Sx1278Chip_Write(const Sx1278ChipBus *bus, uint8_t address,
    const uint8_t *data, uint8_t length)
{
    if ((data == NULL) || (address > 0x7FU)) { return Sx1278Result_Invalid; }
    return Sx1278Chip_Transfer(bus, (uint8_t)(address | 0x80U), data, NULL, length);
}

Sx1278Result Sx1278Chip_RegisterWrite(const Sx1278ChipBus *bus,
    uint8_t address, uint8_t value)
{
    return Sx1278Chip_Write(bus, address, &value, 1U);
}

Sx1278Result Sx1278Chip_ModeSet(const Sx1278ChipBus *bus, uint8_t mode)
{
    uint8_t actual = 0U;
    Sx1278Result result;
    if ((mode != 0U) && (mode != 1U) && (mode != 3U) && (mode != 5U))
    { return Sx1278Result_Invalid; }
    /* LoRa + LF bank (<525 MHz). SX127x has no BUSY pin or command opcodes. */
    result = Sx1278Chip_RegisterWrite(bus, 0x01U, (uint8_t)(0x88U | mode));
    if (result != Sx1278Result_Ok) { return result; }
    result = Sx1278Chip_Read(bus, 0x01U, &actual, 1U);
    if (result != Sx1278Result_Ok) { return result; }
    return (actual == (uint8_t)(0x88U | mode)) ? Sx1278Result_Ok : Sx1278Result_Io;
}

static Sx1278Result Sx1278Chip_Verify(const Sx1278ChipBus *bus,
    uint8_t address, uint8_t value)
{
    uint8_t actual = 0U;
    Sx1278Result result = Sx1278Chip_RegisterWrite(bus, address, value);
    if (result != Sx1278Result_Ok) { return result; }
    result = Sx1278Chip_Read(bus, address, &actual, 1U);
    if (result != Sx1278Result_Ok) { return result; }
    return (actual == value) ? Sx1278Result_Ok : Sx1278Result_Io;
}

static Sx1278Result Sx1278Chip_DetectionConfigure(const Sx1278ChipBus *bus)
{
    uint8_t actual = 0U;
    Sx1278Result result = Sx1278Chip_Read(bus, 0x31U, &actual, 1U);
    if (result != Sx1278Result_Ok) { return result; }
    /* Preserve the read-only/reserved middle bits, clear AutomaticIFOn,
     * and select SF7-12 detection without assuming their reset value. */
    return Sx1278Chip_Verify(bus, 0x31U, (uint8_t)((actual & 0x78U) | 0x03U));
}

Sx1278Result Sx1278Chip_Configure(const Sx1278ChipBus *bus)
{
    /* FRF = 433000000 * 2^19 / 32000000 = 0x6C4000.
     * PA_BOOST +17 dBm: PaDac normal 0x84, OCP enabled 100mA 0x2B.
     * RX/TX FIFO bases both 0: half duplex, read only after standby.
     * Explicit header, CRC on, AGC on, SF7/BW125/CR4-5, normal IQ. */
    static const uint8_t registers[23] = {0x06U,0x07U,0x08U,0x09U,0x0AU,
        0x0BU,0x0CU,0x0EU,0x0FU,0x11U,0x1DU,0x1EU,0x20U,0x21U,
        0x23U,0x26U,0x33U,0x37U,0x39U,0x4DU,0x24U,0x2FU,0x30U};
    static const uint8_t values[23] = {0x6CU,0x40U,0x00U,0x8FU,0x09U,
        0x2BU,0x20U,0x00U,0x00U,0x97U,0x72U,0x74U,0x00U,0x10U,
        61U,0x04U,0x27U,0x0AU,0x12U,0x84U,0U,0x40U,0U};
    uint8_t version = 0U;
    uint8_t index;
    Sx1278Result result = Sx1278Chip_Read(bus, 0x42U, &version, 1U);
    if (result != Sx1278Result_Ok) { return result; }
    /* A register version is a bus sanity check, never module identification. */
    if (version != 0x12U) { return Sx1278Result_NotPresent; }
    /* LongRangeMode may be changed only from sleep, including after reset. */
    result = Sx1278Chip_Verify(bus, 0x01U, 0x00U);
    if (result != Sx1278Result_Ok) { return result; }
    result = Sx1278Chip_Verify(bus, 0x01U, 0x88U);
    if (result != Sx1278Result_Ok) { return result; }
    for (index = 0U; index < 23U; index++)
    {
        result = Sx1278Chip_Verify(bus, registers[index], values[index]);
        if (result != Sx1278Result_Ok) { return result; }
    }
    result = Sx1278Chip_DetectionConfigure(bus);
    if (result != Sx1278Result_Ok) { return result; }
    result = Sx1278Chip_Verify(bus, 0x3BU, 0x1DU);
    if (result != Sx1278Result_Ok) { return result; }
    return Sx1278Chip_Verify(bus, 0x01U, 0x89U);
}
